## conf/layer.conf
```bitbake
BBFILES += "${LAYERDIR}/recipes/*/*.bb ${LAYERDIR}/recipes/*/*.bbappend ${LAYERDIR}/recipes/*/*/*.bb"
BBPATH .= ":${LAYERDIR}"
BBFILE_COLLECTIONS += "qti-qmmf"
BBFILE_PRIORITY_qti-qmmf = "10"
BBFILE_PATTERN_qti-qmmf := "^${LAYERDIR}/"
LAYERSERIES_COMPAT_qti-qmmf = "kirkstone scarthgap"
LAYERVERSION_qti-qmmf = "1"
```
